//TEF6686HN/V102 xdr-gtk控制程序
//作者 eggplant886
// rds add by stailus - base from https://github.com/stailus/tef6686_rds
// niq_ro added some switches using stailus hints
// niq_ro added encoder for volume
// niq_ro added LCD2004 (i2c) 
// niq_ro added RT and PI from RDS data using (again) hints from stailus
// niq_addded PTY
// niq_ro added RT from makserge - https://github.com/makserge/tef6686_radio

#include <Wire.h>
#include <Arduino.h>

#define sw1 5
#define sw2 6
#define sw3 7
#define sw4 8
#define sw5 9
#define sw6 10

#define encoder1 2
#define encoder2 3
#define encodersw 4

#include <Encoder.h> // from http://www.pjrc.com/teensy/td_libs_Encoder.html
Encoder knob(encoder2, encoder1); //encoder connected to pins 2 and 3 (and ground)

#include <LiquidCrystal_I2C.h>  // https://github.com/fdebrabander/Arduino-LiquidCrystal-I2C-library
LiquidCrystal_I2C lcd(0x3F,20,4);  // set the LCD address to 0x27 for a 16 chars and 2 line display

int knobval; // value for the rotation of the knob
//boolean buttonflag = false; // default value for the button flag

byte antena[] = {
  B11111,
  B10101,
  B10101,
  B01110,
  B01110,
  B00100,
  B00100,
  B00100
};


byte difuzor[] = {
  B00001,
  B00011,
  B11101,
  B10101,
  B10101,
  B11101,
  B00011,
  B00001
};

byte difuzor2[] = {
  B10000,
  B11000,
  B10111,
  B10101,
  B10101,
  B10111,
  B11000,
  B10000
};

//byte plus = 0;
int nivel = 0;
//int q = 0;

int16_t nDeemphasis, volume;
uint32_t freq;
char streo;

//rds
char rdsProgramId[5];
char rdsProgramService[9];
char programServiceUnsafe[9];
uint8_t prevAddress = 3;
uint32_t psErrors = 0xFFFFFFFF;
bool psAB;
uint8_t psCharIsSet = 0;
char unsafePs[2][8];
char rdsProgramServiceUnsafe[9];
char rdsProgramType[17];
char rdsRadioText[64];
uint8_t rdsAb;
uint8_t isRdsNewRadioText;
int doarRT0 = 0;
byte doarRT = 0;

uint16_t FREQMIN = 8750;
uint16_t FREQMAX = 10800;

// Serial
#define SERIAL_BUFFER_SIZE 16
char buff[SERIAL_BUFFER_SIZE];
uint8_t buff_pos = 0;
uint16_t REG_FREQ;
uint32_t timer = 0;// Signal level reporting timer
uint32_t timer_rds = 0;// RDS reporting timer
int8_t current_filter = -1;   // Current FIR filter (-1 is adaptive)
int8_t current_set = -1;   // Current FIR filter (-1 is adaptive)


// Scan
uint16_t scan_start = 0;
uint16_t scan_end = 0;
uint16_t scan_step = 0;
uint8_t scan_filter = 0;

#define TIMER_INTERVAL 250
#define RDS_TIMER_INTERVAL 87
#define DSP_I2C 0x64

static const uint8_t DSP_INIT[] PROGMEM =
{
  0x03,0x1c,0x00,0x00,
  0x03,0x1C,0x00,0x74,
  0x19,0x1B,0xF0,0x00,0x38,0x38,0xD0,0x80,0xF0,0x00,0x38,0x40,0xD0,0x80,0x43,0xB2,0x38,0x43,0xD0,0x80,0xF0,0x00,0x70,0x00,0xC2,0xF7,
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  0x07,0x20,0x4B,0x01,0x00,0x01,0x0F,0xA0,                   // FM_Set_StHiBlend_Max (1, 1, 4000)
};

//                                           0    1    2    3     4     5     6     7     8     9    10   11   12   13   14   15    16   17   18   19   20   21   22   23   24   25   26   27   28   29   30   31
const uint8_t FMFilterMap[32] PROGMEM = { 320, 480, 560, 640, 720, 840, 1140, 1330, 1510, 1680, 1840, 2360, 2540, 2860, 3110, 3200, 320, 360, 420, 480, 560, 560, 560, 560, 640, 720, 840, 840, 960, 1140, 1330, 1510 };

void Write(uint8_t *buf, uint8_t len)
{
  Wire.beginTransmission(DSP_I2C);
  for (int i = 0; i < len; i++)
    Wire.write(*buf++);
  Wire.endTransmission();
}

void Read(uint8_t *buf, uint8_t len)
{
  uint8_t lenrec = Wire.requestFrom(DSP_I2C, len);
  for (int i = 0; i < lenrec; i++)
    *buf++ = Wire.read();
}

void Set_Cmd(uint8_t mdl, uint8_t cmd, int len, ...)
{
  uint8_t buf[31];
  uint16_t temp;
  va_list vArgs;
  va_start(vArgs, len);
  buf[0] = mdl;
  buf[1] = cmd;
  buf[2] = 1;
  for (uint8_t i = 0; i< len; i++)
  {
    temp = va_arg(vArgs, uint16_t);
    buf[3 + i * 2] = (uint8_t)(temp >> 8);
    buf[4 + i * 2] = (uint8_t)temp;
  }
  va_end(vArgs);
  Write(buf, len * 2 + 3);
}

void Get_Cmd(uint8_t mdl, uint8_t cmd, uint16_t *receive, int len)
{
  uint8_t buf[3];
  buf[0] = mdl;
  buf[1] = cmd;
  buf[2] = 1;
  Write(buf, 3);
  Read((uint8_t*)receive, 2 * len);
  for (uint8_t i = 0; i < len; i++)
  {
    uint16_t newval = (uint8_t)(receive[i] >> 8) | (((uint8_t)(receive[i])) << 8);
    receive[i] = newval;
  }
}

void dsp_write_data(const uint8_t* data)
{
  uint8_t *pa = (uint8_t *)data;
  uint8_t len, i, first;
  for (;;)
  {
    len = pgm_read_byte_near(pa++);
    first = pgm_read_byte_near(pa);
    if (!len)
      break;
    if (len == 2 && first == 0xff)
    {
      int delaytime = pgm_read_byte_near(++pa);
      delay(delaytime);
      pa++;
    }
    else
    {
      Wire.beginTransmission(DSP_I2C);
      for (int i = 0; i < len; i++)
        Wire.write(pgm_read_byte_near(pa++));
      Wire.endTransmission();
    }
  }
}

void scan(bool continous)
{
  uint32_t freq;
  uint32_t buffer;
  Set_Cmd(32, 10, 4, scan_filter == -1 ? 1 : 0, pgm_read_byte_near(FMFilterMap + scan_filter), 1000, 1000);
  Set_Cmd(32, 1, 2, 1, scan_start);
  do
  {
    Serial.print('U');
    for (freq = scan_start; freq <= scan_end; freq += scan_step)
    {
      Set_Cmd(32, 1, 2, 1, freq);
      Serial.print(freq * 10, DEC);
      Serial.print('=');
      delay(10);
      int16_t uQuality[2] = { 0 };
      Get_Cmd(32, 128, uQuality, 2);
      Serial.print(uQuality[1] / 10, DEC);
      Serial.print(',');
    }
    Serial.print('\n');
  } while (continous && !Serial.available());
  // Restore previous settings
  Set_Cmd(32, 10, 4, current_filter == -1 ? 1 : 0, pgm_read_byte_near(FMFilterMap + current_filter), 1000, 1000);
  Set_Cmd(32, 1, 2, 1, REG_FREQ);
}

void setup()
{
  Wire.begin();
  Serial.begin(115200);
  
  pinMode(sw1, INPUT);
  pinMode(sw2, INPUT);
  pinMode(sw3, INPUT);
  pinMode(sw4, INPUT);
  pinMode(sw5, INPUT);
  pinMode(sw6, INPUT);   
  pinMode(encodersw, INPUT);  
 digitalWrite(sw1, HIGH);
 digitalWrite(sw2, HIGH);
 digitalWrite(sw3, HIGH);
 digitalWrite(sw4, HIGH);
 digitalWrite(sw5, HIGH);
 digitalWrite(sw6, HIGH);
 digitalWrite(encodersw, HIGH);

  lcd.begin(); // initialize the LCD
  lcd.createChar(0, antena);
  lcd.createChar(1, difuzor);
  lcd.createChar(2, difuzor2);
  // Print a message to the LCD.
  lcd.backlight();
  lcd.clear(); 
  // Print a logo message to the LCD.
  lcd.setCursor(0,0);
  lcd.print(" TEF6686 radio v.7.2");
  lcd.setCursor(0,1);
  lcd.print(" github.com/stailus ");
  lcd.setCursor(0,2);
  lcd.print("  updated by niq_ro ");
  lcd.setCursor(0,3);
  lcd.print(" github.com/tehniq3 ");
  delay (3000);
  lcd.clear();
    
  delay(40);
  uint16_t uState;
  Get_Cmd(64, 128, &uState, 1);
  if (uState < 2)
    dsp_write_data(DSP_INIT);
  else if (uState > 2)
  {
    Set_Cmd(64, 1, 1, 0);
  }
/*  
  while (true)
  {
    if (Serial.available() > 0)
    {
      if (Serial.read() == 'x')
      {
        while (!Serial.available());
        if (Serial.read() == '\n')
          break;
      }
    }
  }

  delay(20);
  
  while (Serial.available() > 0)
    Serial.read();  // clear the serial buffer
  Serial.print("\nOK\n");
*/

 Set_Cmd(32, 31, 1, 500);
 
//REG_FREQ2 = 131.4;
   Set_Cmd(48, 11, 1, 0);//unmute
  volume = 56;
  Set_Cmd(48, 10, 1, volume * 7 - 600);
  REG_FREQ = 8870;
  Set_Cmd(32, 1, 2, 1, REG_FREQ);
  
  clearRDS();
}

void loop()
{

 knob.write(0);
    lcd.setCursor(19,1);
    lcd.print(" ");
    knobval = knob.read();
    if (knobval < -1) { //bit of software de-bounce
      knobval = -4;
     lcd.setCursor(19,1);
    lcd.print("+");
    }
    if (knobval > 1) {
      knobval = 4;
        lcd.setCursor(19,1);
        lcd.print("-");
    }

 if (knobval != 0) 
    {   
      volume += knobval; 
      if (volume < 0) volume = 0;
      if (volume > 100) volume = 100;
      Serial.print("Y");
      Serial.println(volume);
      Set_Cmd(48, 10, 1, volume * 7 - 600);
      delay(50);
    }


if (digitalRead(sw1) == LOW)
    {
      volume -= 4;
      if (volume < 0) volume = 0;
      Serial.print("Y");
      Serial.println(volume);
      Set_Cmd(48, 10, 1, volume * 7 - 600);
    } 
    
if (digitalRead(sw2) == LOW)
    {
      volume += 4;
      if (volume > 100) volume = 100;
      Serial.print("Y");
      Serial.println(volume);
      Set_Cmd(48, 10, 1, volume * 7 - 600);
      delay(250);
    } 

if (digitalRead(sw3) == LOW)
    {
      clearRDS();
     Serial.println("f+");
     REG_FREQ -= 10;
     if (REG_FREQ < FREQMIN) REG_FREQ = FREQMAX;
 //    Serial.print("T");
     Serial.println(REG_FREQ*10);
     Set_Cmd(32, 1, 2, 1, REG_FREQ);//freq- 
      Serial.print('V');
        Serial.print(60, DEC);  // Pseudo DAA
        Serial.print("\nT");
        Serial.print((uint32_t)REG_FREQ * 10, DEC);
        Serial.print('\n');
      delay(250);
    } 

if (digitalRead(sw4) == LOW)
    {
      clearRDS();
    Serial.println("f+");
    REG_FREQ += 10;
    if (REG_FREQ > FREQMAX) REG_FREQ = FREQMIN;
 //   Serial.print("T");
    Serial.println(REG_FREQ*10);
    Set_Cmd(32, 1, 2, 1, REG_FREQ);//freq+ 
     Serial.print('V');
        Serial.print(60, DEC);  // Pseudo DAA
        Serial.print("\nT");
        Serial.print((uint32_t)REG_FREQ * 10, DEC);
        Serial.print('\n');
    delay(250);
    } 

if (digitalRead(sw5) == LOW)
    {
      clearRDS();
  Serial.println("scan-");
     int16_t uQuality1[2] = { 0 };
     while (uQuality1[1] / 10 < 42)
//      while (uQuality1[2] / 10 > 9)
     {
    REG_FREQ -= 10;
    if (REG_FREQ < FREQMIN) REG_FREQ = FREQMAX;
 //   Serial.print("T");
    Serial.println(REG_FREQ*10);
    Set_Cmd(32, 1, 2, 1, REG_FREQ);//freq+ 
     Serial.print('V');
        Serial.print(60, DEC);  // Pseudo DAA
        Serial.print("\nT");
        Serial.print((uint32_t)REG_FREQ*10, DEC);
        Serial.print('\n');
        delay(75);
   //uQuality1[2] = { 0 };
   Get_Cmd(32, 128, uQuality1, 8);
       Serial.println(uQuality1[1] / 10);
    }
    } 

if (digitalRead(sw6) == LOW)
    {
      clearRDS();
    Serial.println("scan+");
     int16_t uQuality1[2] = { 0 };
     while (uQuality1[1] / 10 < 42)
//      while (uQuality1[2] / 10 > 9)
     {
    REG_FREQ += 10;
    if (REG_FREQ > FREQMAX) REG_FREQ = FREQMIN;
 //   Serial.print("T");
    Serial.println(REG_FREQ*10);
    Set_Cmd(32, 1, 2, 1, REG_FREQ);//freq+ 
     Serial.print('V');
        Serial.print(60, DEC);  // Pseudo DAA
        Serial.print("\nT");
        Serial.print((uint32_t)REG_FREQ*10, DEC);
        Serial.print('\n');
        delay(75);
   //uQuality1[2] = { 0 };
   Get_Cmd(32, 128, uQuality1, 8);
       Serial.println(uQuality1[1] / 10);
    }
    }
 
  // check signal level and 19kHz subcarrier every TIMER_INTERVAL
  if ((millis() - timer) >= TIMER_INTERVAL)
  {
    Serial.print('S');
    uint16_t uStatus;
    Get_Cmd(32, 133, &uStatus, 1);
    streo = (uStatus & (1 << 15)) ? 's' : 'm';
    Serial.print(streo);
    int16_t uQuality[4] = { 0 };
    Get_Cmd(32, 128, uQuality, 8);
    Serial.print(uQuality[1] / 10, DEC);
     nivel = uQuality[1] / 10;
    Serial.print(',');
    Serial.print(uQuality[3] / 10, DEC);
    Serial.print(',');
    Serial.print(uQuality[2] / 10, DEC);
    Serial.print('\n');
    timer = millis();
  }


  if ((millis() - timer_rds) >= RDS_TIMER_INTERVAL)
  {
    lcd.setCursor(10,0);
    //q = 0;
    get_RDS();
    timer_rds = millis();
    
  }

/*
  int16_t nDeemphasis, volume;
  uint32_t freq;
*/
  if (Serial.available() > 0)
  {
    buff[buff_pos] = Serial.read();
    if (buff[buff_pos] != '\n' && buff_pos != SERIAL_BUFFER_SIZE - 1)
      buff_pos++;
    else {
      buff[buff_pos] = 0x00;
      buff_pos = 0;
      switch (buff[0])
      {
      case 'x':
        Serial.println("OK");
        break;
      case 'D':  // Change the de-emphasis
        nDeemphasis = atoi(buff + 1);
        if (nDeemphasis == 0)
          Set_Cmd(32, 31, 1, 500);
        else  if (nDeemphasis == 1)
          Set_Cmd(32, 31, 1, 750);
        else if (nDeemphasis == 2) {
          Set_Cmd(32, 31, 1, 0);
        }
        Serial.print("D");
        Serial.println(nDeemphasis);
        break;
      case 'Y':  // Audio volume scaler
        volume = atoi(buff + 1);
        if(volume == 0){
          Set_Cmd(48, 11, 1, 1);//mute
        } else {
          Set_Cmd(48, 11, 1, 0);//unmute
          Set_Cmd(48, 10, 1, volume * 7 - 600);
        }
        Serial.print("Y");
        Serial.println(volume);
        break;
      case 'S':
        if (buff[1] == 'a')
        {
          scan_start = (atol(buff + 2) + 5) / 10;
          Serial.println("Sa");
        }
        else if (buff[1] == 'b')
        {
          scan_end = (atol(buff + 2) + 5) / 10;
          Serial.println("Sb"); 
        }
        else if (buff[1] == 'c')
          scan_step = atol(buff + 2) / 10;
        else if (buff[1] == 'f')
          scan_filter = atol(buff + 2);
        else if (scan_start > 0 && scan_end > 0 && scan_step > 0 && scan_filter >= 0)
        {
          if (buff[1] == 'm')
          {
            scan(true);   // Multiple (continous) scan
            Serial.println("Smultiple"); 
          }
          else
          {
            scan(false);  // Single scan
            Serial.println("Ssingle");
          }
        }
        break;
     case 'T':  // Tune to a frequency
        freq = atol(buff + 1);
        REG_FREQ = (freq + 5) / 10;
        Set_Cmd(32, 1, 2, 1, REG_FREQ);
        Serial.print('V');
        Serial.print(60, DEC);  // Pseudo DAA
        Serial.print("\nT");
        Serial.print((uint32_t)REG_FREQ * 10, DEC);
        Serial.print('\n');
        break;
      case 'F':  // Change FIR filters
        current_filter = atoi(buff + 1);
        Set_Cmd(32, 10, 4, current_filter == -1 ? 1 : 0, pgm_read_byte_near(FMFilterMap + current_filter), 1000, 1000);
        Serial.print('F');
        Serial.println(buff + 1);
        break;
      case 'X':  // shutdown
        Set_Cmd(64, 1, 1, 1);
        TWCR = 0;  // Release SDA and SCL lines used by hardware I2C
        Serial.println("X");
        delay(10);
        asm("jmp 0");
        break;
      }
    }
  }

displayInfo();

doarRT0 = doarRT0 + 1;
if (doarRT0 % 50 == 0) doarRT = doarRT + 1;
}  // end main loop

void get_RDS()
 {
// https://en.wikipedia.org/wiki/Radio_Data_System#Program_types
/*
const char* ptyLUT[51] = { // America
      "      None      ",
      "      News      ",
      "  Information   ",
      "     Sports     ",
      "      Talk      ",
      "      Rock      ",
      "  Classic Rock  ",
      "   Adult Hits   ",
      "   Soft Rock    ",
      "     Top 40     ",
      "    Country     ",
      "     Oldies     ",
      "      Soft      ",
      "   Nostalgia    ",
      "      Jazz      ",
      "   Classical    ",
      "Rhythm and Blues",
      "   Soft R & B   ",
      "Foreign Language",
      "Religious Music ",
      " Religious Talk ",
      "  Personality   ",
      "     Public     ",
      "    College     ",
      " Reserved  -24- ",
      " Reserved  -25- ",
      " Reserved  -26- ",
      " Reserved  -27- ",
      " Reserved  -28- ",
      "     Weather    ",
      " Emergency Test ",
      "  !!!ALERT!!!   ",
      "Current Affairs ",
      "   Education    ",
      "     Drama      ",
      "    Cultures    ",
      "    Science     ",
      " Varied Speech  ",
      " Easy Listening ",
      " Light Classics ",
      "Serious Classics",
      "  Other Music   ",
      "    Finance     ",
      "Children's Progs",
      " Social Affairs ",
      "    Phone In    ",
      "Travel & Touring",
      "Leisure & Hobby ",
      " National Music ",
      "   Folk Music   ",
      "  Documentary   "};
*/

char* ptyLUT[51] = {   // Europe
      "      None      ",
      "      News      ",
      " Current Affairs",
      "   Information  ",
      "      Sport     ",
      "    Education   ",
      "     Drama      ",
      "     Culture    ",
      "     Science    ",
      "    Variable    ",
      "    Pop Music   ",
      "   Rock Music   ",
      "  Easy Listening",
      " Light Classical",
      "SeriousClassical",
      "  Other Music   ",
      "     Weather    ",
      "     Finance    ",
      " Childrens Prog ",
      " Social Affairs ",
      " Religious Talk ",
      "  Phone-In Talk ",
      "     Travel     ",
      "    Leisure     ",
      "   Jazz Music   ",
      "  Country Music ",
      "  National Music",
      "  Oldies Music  ",
      "   Folk Music   ",
      "   Documentary  ",
      " Emergency Test ",
      "  !!!ALERT!!!   ",
      "Current Affairs ",
      "   Education    ",
      "     Drama      ",
      "    Cultures    ",
      "    Science     ",
      " Varied Speech  ",
      " Easy Listening ",
      " Light Classics ",
      "Serious Classics",
      "  Other Music   ",
      "    Finance     ",
      "Children's Progs",
      " Social Affairs ",
      "    Phone In    ",
      "Travel & Touring",
      "Leisure & Hobby ",
      " National Music ",
      "   Folk Music   ",
      "  Documentary   "};
  
   int16_t uRds_Data[6] = {0};
   Get_Cmd(32, 131, uRds_Data, 8);

   if ( bitRead(uRds_Data[0], 15) == 1 )
    {
      Serial.print('P');
   //   lcd.print(10+q,0);
      serial_hex(uRds_Data[1] >> 8);
      lcd1_hex(uRds_Data[1] >> 8);
      serial_hex(uRds_Data[1]);
      lcd1_hex(uRds_Data[1]);
     // q++;
     // q = q%4;
      Serial.print('\n');

      Serial.print('R');
      serial_hex(uRds_Data[2] >> 8);
      serial_hex(uRds_Data[2]);
   //   Serial.print('/');
      serial_hex(uRds_Data[3] >> 8);
     serial_hex(uRds_Data[3]);
   //   Serial.print('/');
      serial_hex(uRds_Data[4] >> 8);
      serial_hex(uRds_Data[4]);
  //    Serial.print('/');
     serial_hex(uRds_Data[5] >> 8);
      Serial.print('\n');

//uint8_t rdsBHigh, rdsBLow, rdsCHigh, rdsCLow, rdsDHigh, rdsDLow, isPsReady;
  uint8_t rdsBHigh, rdsBLow, rdsCHigh, rdsCLow, rdsDHigh, isReady, rdsDLow;
    rdsBHigh = (uint8_t)(uRds_Data[2] >> 8);
    rdsBLow = (uint8_t)uRds_Data[2];
    rdsCHigh = (uint8_t)(uRds_Data[3] >> 8);
    rdsCLow = (uint8_t)uRds_Data[3];
    rdsDHigh = (uint8_t)(uRds_Data[4] >> 8);
    rdsDLow = (uint8_t)uRds_Data[4];
    
 uint8_t errA = (uRds_Data[5] & 0b1100000000000000) >> 14;
    uint8_t errB = (uRds_Data[5] & 0b0011000000000000) >> 12;
    uint8_t errC = (uRds_Data[5] & 0b0000110000000000) >> 10;
    uint8_t errD = (uRds_Data[5] & 0b0000001100000000) >> 8;
    
   // group type (0: PS, 2: RT, 4: CT, 10: PTYN

 // PTY
  if (errB <= 1) {
    uint8_t programType = ((rdsBHigh & 3) << 3) | ((rdsBLow >> 5) & 7);
    strcpy(rdsProgramType, (programType >= 0 && programType < 32) ? ptyLUT[programType] : "    PTY ERROR   ");
  }   

//    Serial.println(rdsProgramType);
      
    uint8_t type = (rdsBHigh >> 4) & 15;      
    
uint8_t version = bitRead(rdsBHigh, 4);
  
  // Groups 0A & 0B
  // Basic tuning and switching information only
  if (type == 0) {
    uint8_t address = rdsBLow & 3;
    // Groups 0A & 0B: to extract PS segment we need blocks 1 and 3
    if (address >= 0 && address <= 3) {
      if (rdsDHigh != '\0') {
        rdsProgramService[address * 2] = rdsDHigh;
      }  
      if (rdsDLow != '\0') {
        rdsProgramService[address * 2 + 1] = rdsDLow;
      }  
      isReady = (address == 3) ? 1 : 0;
    } 
    rdsFormatString(rdsProgramService, 8);
  }
  // Groups 2A & 2B
  // Radio Text
  else if (type == 2) {
    uint16_t addressRT = rdsBLow & 15;
    uint8_t ab = bitRead(rdsBLow, 4);
    uint8_t cr = 0;
    uint8_t len = 64;
    if (version == 0) {
      if (addressRT >= 0 && addressRT <= 15) {
        if (rdsCHigh != 0x0D) {
          rdsRadioText[addressRT*4] = rdsCHigh;
        }  
        else {
          len = addressRT * 4;
          cr = 1;
        }
        if (rdsCLow != 0x0D) {
          rdsRadioText[addressRT * 4 + 1] = rdsCLow;
        }  
        else {
          len = addressRT * 4 + 1;
          cr = 1;
        }
        if (rdsDHigh != 0x0D) {
          rdsRadioText[addressRT * 4 + 2] = rdsDHigh;
        }  
        else {
          len = addressRT * 4 + 2;
          cr = 1;
        }
        if (rdsDLow != 0x0D) {
          rdsRadioText[addressRT * 4 + 3] = rdsDLow;
        }
        else {
          len = addressRT * 4 + 3;
          cr = 1;
        }
      }
    }
    else {
      if (addressRT >= 0 && addressRT <= 7) {
        if (rdsDHigh != '\0') {
          rdsRadioText[addressRT * 2] = rdsDHigh;
        }  
        if (rdsDLow != '\0') {
          rdsRadioText[addressRT * 2 + 1] = rdsDLow;
        }
      }
    }
    if (cr) {
      for (uint8_t i = len; i < 64; i++) {
        rdsRadioText[i] = ' ';
      }
    }
    if (ab != rdsAb) {      
      for (uint8_t i = 0; i < 64; i++) {
        rdsRadioText[i] = ' ';
      }
      rdsRadioText[64] = '\0';     
      isRdsNewRadioText = 1;
    }
    else {
      isRdsNewRadioText = 0;
    }
    rdsAb = ab;
    rdsFormatString(rdsRadioText, 64);
  }


//Serial.println(rdsRadioText);
 
  lcd.setCursor(10,1);
  lcd.print(rdsProgramService); 

    }
 }

void serial_hex(uint8_t val)
 {
    Serial.print((val >> 4) & 0xF, HEX);
    Serial.print(val & 0xF, HEX);
 }

void lcd1_hex(uint8_t val)
 {
   // lcd.print(10+q,2);
    lcd.print((val >> 4) & 0xF, HEX);
    lcd.print(val & 0xF, HEX);
    //q++;
 }

/* XDR-GTK/XDR_I2C interface filter index to TEF6686 filter index remap

|--          XDR-GTK/XDR_I2C         --|   |-- TEF6686 FM --|  |-- TEF6686 AM --|
FM BW*    AM BW*   XDR-GTK/XDR_I2C Index    FM BW    BW3-BW0    AM BW     BW3-BW0

Auto                       -1                Auto       0
9k       1.1k            31                 56k       1       3k       1
15k       1.9k            16                 56k       1       4k       1
17k       2.2k            17                 56k       1       6k       2
20k       2.5k            18                 56k       1       8k       3
24k       2.9k            19                 56k       1       8k       4
27k       3.4k            20                 56k       1       8k       5
32k       3.9k            21                 56k       1       8k       6
36k       4.6k            22                 56k       1       8k       7
42k       5.2k            23                 56k       1       8k       8
48k       6.0k            24                 56k       1       8k       9
55k       6.9k             0                 56k       1       8k      10
63k       7.9k            26                 64k       1       8k      11
73k       9.1k             1                 72k       1       8k      12
83k      10.4k            28                 84k       2       8k      13
90k      11.3k             2                 84k       2       8k      14
95k      11.8k            29                 97k       2       8k      14
108k      13.5k             3                114k       3       8k      15
125k      15.6k             4                133k       4       8k      15
142k      17.8k             5                151k       5       8k      15
159k      19.9k             6                168k       6       8k      15
177k      22.1k             7                184k       7       8k      15
194k      24.3k             8                200k       8       8k      15
211k      26.4k             9                217k       9       8k      15
229k      28.6k            10                236k      10       8k      15
246k      30.8k            11                254k      11       8k      15
263k      32.9k            12                287k      12       8k      15
281k      35.1k            13                311k      13       8k      15
298k      37.3k            14                311k      14       8k      15
309k      38.6k            15                311k      15       8k       0
*/

void displayInfo() {

    // frequency
    lcd.setCursor(0, 0);
    if (REG_FREQ < 10000) lcd.print(" ");
    lcd.print(REG_FREQ/100); 
    lcd.print(",");
    lcd.print(REG_FREQ%100/10); // thanks to carkiller08
    lcd.print(REG_FREQ%10);
    lcd.print("MHz");

   // stereo
    lcd.setCursor(0,1);
    if (streo == 's')
    {
    lcd.write(2);  // speaker2 sign
    }
    else
    lcd.print(" ");   
   
    // volume
    lcd.setCursor(1,1);
    lcd.write(1);  // speaker sign
    if (volume < 100) lcd.print(" ");
    if (volume < 10) lcd.print(" ");    
    lcd.print(volume);
    lcd.print("% ");

    // antenna level
 //   nivel = uQuality[1] / 10;
    if (nivel > 100) nivel = 0;
    lcd.setCursor(15,0);
    if (nivel < 100)
    lcd.print(" "); 
    if (nivel < 10)
    lcd.print(" ");      
    lcd.print(nivel);
    lcd.print("%");
    lcd.write(0);  // antenna sign

    // programID (PI)
 //   lcd.setCursor(10,0);
 //    lcd.print(serial_hex(uRds_Data[1] >> 8));
 //    lcd.print(serial_hex(uRds_Data[1]));
    //lcd.print("Pi: ");
    //lcd.print(programIdPrevious); 
//    lcd.print(" ");

    /*
     lcd.setCursor(0,3);
 //   lcd.print(programTypePrevious); 
     lcd.print("PTY:");
 //   lcd.print(programTypePrevious); 
       for (int i = 0; i < 15; i++) 
     {
   //   Serial.print(programTypePrevious[i]);
      lcd.setCursor(i+4,3);
      lcd.print(rdsProgramType[i]);   
     }   
*/

if (doarRT % 2 == 0)
{
    //PTY
    /*
    lcd.setCursor(0,2);
    lcd.print("                    ");
    lcd.setCursor(0,3);
    lcd.print("                    ");
    */
 //   Serial.print(programTypePrevious);
 //   Serial.println();
     lcd.setCursor(0,3);
 //   lcd.print(programTypePrevious); 
     lcd.print("PTY:");
 //   lcd.print(programTypePrevious); 
       for (int i = 0; i < 15; i++) 
     {
 //     Serial.print(programTypePrevious[i]);
      lcd.setCursor(i+4,3);
      lcd.print(rdsProgramType[i]);   
     }

    for (int i = 0; i < 20; i++) 
     {
   //   Serial.print(rdsRadioText[i]);
      lcd.setCursor(i,2);
      lcd.print(rdsRadioText[i]);   
     }
}
else
{
    // RadioText
/*     
     lcd.setCursor(0,2);
     lcd.print("                    ");
     lcd.setCursor(0,3);
     lcd.print("                    ");
 */    
     for (int i = 0; i < 20; i++) 
     {
 //     Serial.print(rdsRadioText[i]);
      lcd.setCursor(i,2);
      lcd.print(rdsRadioText[i]);   
     }
     for (int i = 20; i < 40; i++) 
     {
   //   Serial.print(rdsRadioText[i]);
      lcd.setCursor(i-20,3);
      lcd.print(rdsRadioText[i]);   
     }
}



}

void clearRDS() {
      lcd.setCursor(10,0);
      lcd.print("    ");
      lcd.setCursor(10,1);
      lcd.print("        ");
      lcd.setCursor(0,2);
      lcd.print("                    ");
      lcd.setCursor(0,3);
      lcd.print("                    ");
  strcpy(rdsProgramService, "        ");
  strcpy(rdsProgramServiceUnsafe, "        ");
  strcpy(rdsProgramType, "                ");
  strcpy(rdsRadioText, "                                        ");
  psErrors = 0xFFFFFFFF;
  psCharIsSet = 0;
}

void rdsFormatString(char* str, uint16_t length) {
  for (uint16_t i = 0; i < length; i++) {
    if ((str[i] != 0 && str[i] < 32) || str[i] > 126 ) {
      str[i] = ' ';
    }
  }
}
